## config/boards/shields/moudabella/Kconfig.defconfig
```kconfig
if SHIELD_MOUDABELLA_PMW3610 || SHIELD_MOUDABELLA_PAW3395

config ZMK_KEYBOARD_NAME
	default "moudabella"

endif
```

## config/boards/shields/moudabella/Kconfig.shield
```kconfig
# Copyright (c) 2020 Pete Johanson
# SPDX-License-Identifier: MIT

config SHIELD_MOUDABELLA_PMW3610
	def_bool $(shields_list_contains,moudabella_pmw3610)

config SHIELD_MOUDABELLA_PAW3395
	def_bool $(shields_list_contains,moudabella_paw3395)
```
